## src/platforms/zephyr/src/Kconfig
```kconfig
#
# This file is part of AtomVM.
#
# Copyright 2023 Winford (Uncle Grumpy) <winford@object.stream>
#
# Licensed under the Apache License, Version 2.0 (the "License");
# you may not use this file except in compliance with the License.
# You may obtain a copy of the License at
#
#    http://www.apache.org/licenses/LICENSE-2.0
#
# Unless required by applicable law or agreed to in writing, software
# distributed under the License is distributed on an "AS IS" BASIS,
# WITHOUT WARRANTIES OR CONDITIONS OF ANY KIND, either express or implied.
# See the License for the specific language governing permissions and
# limitations under the License.
#
# SPDX-License-Identifier: Apache-2.0 OR LGPL-2.1-or-later

# menu "AtomVM options"

config ATOMVM_DISABLE_SMP
  bool "Disable SMP for single core devices"
  default y if SOC_SERIES_ESP32S2 || SOC_SERIES_ESP32C3
  default y if SOC_SERIES_STM32F0X || SOC_SERIES_STM32F1X || SOC_SERIES_STM32F2X
  default y if SOC_SERIES_STM32F3X || SOC_SERIES_STM32F4X || SOC_SERIES_STM32F7X
  default y if SOC_SERIES_STM32H5X || SOC_SERIES_STM32H7X
  default n
  select CONFIG_SMP if !ATOMVM_DISABLE_SMP
  help
    Devices with only one cpu will suffer a performance penaly if SMP is enabled.

config AVM_USE_32BIT_FLOAT
	bool "Single precision floats"
	default y
	depends on CONFIG_CPU_HAS_FPU_DOUBLE_PRECISION
	help
	  Use 32-bit floats for FPU devices that lack double precision hardware support.

config AVM_VERBOSE_ABORT
    bool "Verbose abort"
    default no
    help
      Print module and line number on VM abort.

config AVM_CREATE_STACKTRACES
    bool "Create stacktraces"
    default y
    help
      Create BEAM stacktraces.

config AVM_LOG_DISABLE
    bool "Disable logging"
    default n
    help
      Disable log output.

# menu "Logging options"

config AVM_ENABLE_LOG_COLOR
    bool "Color logs"
    depends on !AVM_LOG_DISABLE
    default n
    help
      Use colorized log level output.

config AVM_ENABLE_LOG_LINES
    bool "Include source and line info for all log levels"
    depends on !AVM_LOG_DISABLE
    default n
    help
      Include source and line info for all enabled levels, not just errors.

choice AVM_LOG_LEVEL_MAX
    prompt "Max log level"
    default LOG_NONE if AVM_LOG_DISABLE
    default LOG_INFO if !AVM_LOG_LEVEL_MAX
    help
      The maximum log level to display.

config LOG_NONE
    bool "Disable all log messages"
    help
      Do not display any log messages from the VM.

config LOG_ERROR
    bool "Only display error messages"
    help
      Only display error messages in the console logs.

config LOG_WARN
    bool "Display only warning and error messages"
    help
      Display only warnings and errors in the console log.

config LOG_INFO
    bool "Display information logs"
    help
      Display informational messages in the console log.

config LOG_DEBUG
    bool "Display debugging and low-level logs"
    help
      Maximum log verbosity will display low level debug logs.

endchoice
# endmenu  "Logging options"

config REBOOT_ON_NOT_OK
    bool "Reboot if app exits not 'ok'"
    default n
    help
      Reboot when application exits with non 'ok' return value.

# endmenu  "AtomVM options"
```
